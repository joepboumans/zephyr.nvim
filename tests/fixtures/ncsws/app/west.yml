## tests/fixtures/ncsws/app/west.yml
```yaml
manifest:
  remotes:
    - name: vt
      url-base: https://example.com/vt
  defaults:
    remote: vt
  projects:
    - name: nrf
      repo-path: sdk-nrf
      revision: vt-v2.9.2-v1.5
      import:
        name-allowlist:
          - zephyr
          - mcuboot
    - name: zephyr
      revision: vt-3.7.99-ncs2-2-v1.7 # our Zephyr fork
    - name: nrflib
      revision: main
  self:
    path: app
    # exports nrflib and scripts next to the App
```

## tests/fixtures/ncsws/nrf/west.yml
```yaml
manifest:
  remotes:
    - name: ncs
      url-base: https://github.com/nrfconnect
  defaults:
    remote: ncs
  projects:
    - name: zephyr
      repo-path: sdk-zephyr
      revision: v3.7.99-ncs2
      import: true
    - name: mcuboot
      revision: v2.1.0-ncs3
      path: bootloader/mcuboot
  self:
    path: nrf
```
